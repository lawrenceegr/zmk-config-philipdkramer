## config/boards/shields/philipdkramer/Kconfig.shield
```kconfig
# Copyright (c) 2020 The ZMK Contributors
# SPDX-License-Identifier: MIT

config SHIELD_PHILIPDKRAMER
    def_bool $(shields_list_contains, philipdkramer)
```
